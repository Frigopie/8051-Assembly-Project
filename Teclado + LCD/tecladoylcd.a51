											
			;TRABAJO SIST. MICROPROGRAMABLES 2008     

			;FRECUENCIMETRO Y GENERADOR DE SEÑALES CUADRADAS

			;Santiago J. González Fabián

;CONSTANTES DECLARADAS DEL FRECUENCIMETRO


UNIDADES 	EQU 62H		  ;UNIDADES DE LA FRECUENCIA CONVERTIDA A BCD
DECENAS 	EQU 61H		  ;DECENAS DE LA FRECUENCIA CONVERTIDA A BCD
CENTENAS 	EQU 60H		  ;CENTENAS DE LA FRECUENCIA CONVERTIDA A BCD
MILLARES	EQU 63H		  ;MILLARES DE LA FRECUENCIA CONVERTIDA A BCD 

TEMP1   	EQU 65H
TEMP2       EQU 7AH		  
TEMP3       EQU 7BH       

SUMAUNI 	EQU 79H
SUMADEC 	EQU 78H
SUMACEN		EQU 77H
SUMAMIL 	EQU 76H

CENHZH  	EQU 75H		   ;CENTENAS DE LA PARTE ALTA DEL FRECUENCIMETRO CONVERTIDO A BCD
DECHZH		EQU 74H		   ;DECENAS DE LA PARTE ALTA DEL FRECUENCIMETRO CONVERTIDO A BCD
UNIHZH		EQU 73H		   ;UNIDADES DE LA PARTE ALTA DEL FRECUENCIMETRO CONVERTIDO A BCD

HZ_H		EQU 72H		   ;PARTE ALTA DEL FRECUENCIMETRO EN BINARIO
HZ_L		EQU 71H		   ;PARTE BAJA DEL FRECUENCIMETRO EN BINARIO

SEGUR		EQU 70H		
SEGUR2		EQU 69H	

TIMERALTO	EQU 3EH
TIMERBAJO	EQU 3FH						   
MCENTON		EQU 3CH	   						
CENTON		EQU 30H		   ;COMPONENTES DEL TIEMPO EN ON GUARDADOS EN BCD	 						(LINEAS 530-550)
MILTON		EQU 31H
DMILTON		EQU 32H
CMILTON		EQU 33H
SEGTON		EQU 34H
MCENTONAUX	EQU 3DH
CENTONAUX	EQU 35H		   ;COMPONENTES DEL TIEMPO EN ON AUXILIARES
MILTONAUX	EQU 36H
DMILTONAUX	EQU 37H
CMILTONAUX	EQU 38H
SEGTONAUX	EQU 39H

TIEMPO1     EQU 3AH		   ;EN ESTAS VARIABLES SE GUARDARA US,MS O SG DEPENDIENDO DE LAS VARIABLES CENTON,MILTON...SEGTON
TIEMPO2		EQU 3BH		   ;PARA MOSTRAR EL TIEMPO EN ON EN LAS UNIDADES ADECUADAS					( LINEA Nº 471-507)
			
SALTAAFRECM1	EQU 4CH			
/**.*.*.*.*.*.*.*.*.*.*.*.*.*.*.*.*.*.*.*.*.*.*.*.*.*.*.*.*.*.*.*.*.*.*.*.*.*.*.*.*.*.*.*.*.*.*.*.*.*.*.*/			
			
;CONSTANTES DECLARADAS DEL GENERADOR DE SEÑALES CUADRADAS	
;libres de la 40 a la 69 todavia   y 3c a 3f tambien

DUTYPORCEN		EQU 40H
UNIGEN		EQU 41H
DECGEN		EQU 42H
CENGEN		EQU 43H
MILGEN		EQU 44H		
DUTY_ON		EQU 45H
DUTY_OFF	EQU 46H
COPIAR2		EQU 47H
COPIAR3		EQU 48H
COPIAR4		EQU 49H
COPIAR5		EQU 4AH
COPIAR6		EQU 4BH


/**.*.*.*.*.*.*.*.*.*.*.*.*.*.*.*.*.*.*.*.*.*.*.*.*.*.*.*.*.*.*.*.*.*.*.*.*.*.*.*.*.*.*.*.*.*.*.*.*.*.*.*/

;INICIO DEL PROGRAMA PRINCIPAL
				
			ORG 0000H
			JMP INICIO
;____________________________________
			ORG 0003H					  			;INT0
			
			;CALL INTER0
		  	
			RETI
;____________________________________
			ORG 000BH					  			;TIMER0				 
			
			;CALL TIEMPOON							;CONFIGURARLO PARA QUE LO HAGA SOLO UNA VEZ CADA REFRESCO DE PANTALLA
				
			RETI
;____________________________________
			ORG 0013H					  			;INT1
			
			;CALL INTER1												;METER UN INVERSOR EN EL DISEÑO PARA QUE SE ACTIVE A FLANCO ASCENDENTE
			
			RETI
;____________________________________
			ORG 001BH					  			;TIMER1
			
			;CALL REFRESCO

			RETI			
;____________________________________
			ORG 0023H
			RETI									 ;SCON
			
;____________________________________



			ORG 0100H
INICIO:		MOV A,#38			   					 ;COMIENZO DE LA INICIALIZACIÓN DE LA LCD
			CALL ESCINST1		   				
			CALL TIEMPO
			MOV A,#38H
			CALL ESCINST1
			CALL TIEMPO
			MOV A,#38H
			CALL ESC_INST
			MOV A,#38H
			CALL ESC_INST
			MOV A,#04H
			CALL ESC_INST
			MOV A,#01H
			CALL ESC_INST
			MOV A,#08H
			CALL ESC_INST
			MOV A,#0FH
			CALL ESC_INST
			JMP CONT
ESCINST1:	
			MOV DPTR,#4000H
			MOVX @DPTR,A
			RET
ESC_INST:
			MOV DPTR,#4000H
			MOVX @DPTR,A
			CALL CHECK_BF
			RET
CHECK_BF:
			MOV DPTR,#4002H
S1:			MOVX A,@DPTR
			JB ACC.7,S1
			RET
ESC_DATO:
			MOV R0,DPL
			MOV R1,DPH
			MOV DPTR,#4001H
			MOVX @DPTR,A
			CALL CHECK_BF
			MOV DPL,R0
			MOV DPH,R1
			RET

TIEMPO: 	MOV R7,#2   						
S2:			MOV R6,#250
S3:			DJNZ R6,S3
			DJNZ R7,S2
			RET		
TIEMPOPRES:	MOV R7,#250D   						
S25:		MOV R6,#250D
S35:		DJNZ R6,S35
			DJNZ R7,S25
			RET									;FIN DE LA INICIALIZACIÓN DE PANTALLA LCD

/************* CONTINUACIÓN DEL PROGRAMA PRINCIPAL *************
************** MUESTRA POR PANTALLA LOS TEXTOS DE  ************* 
************** PRESENTACIÓN Y SELECCION DE MODO    *************/

CONT:		MOV A,#80H							;MUESTRA POR PANTALLA 
			CALL ESC_INST						;'Presiona una tecla para continuar'
			MOV DPTR,#0F81H
			MOV R3,#242D
			CALL TEXTO3
			MOV A,#0C0H
			CALL ESC_INST
			MOV DPTR,#10F0H
			MOV R3,#242D
			CALL TEXTO3	
					
			MOV P1,#0F0H
NO_TECLA:	CALL TIEMPOPRES
			MOV A,#1CH
			CALL ESC_INST

			MOV A,P1			   				;COMPRUEBA QUE NO 
			CJNE A,#0F0H,S4						;HAYA TECLAS PULSADAS
			JMP NO_TECLA						 
S4:			MOV A,#01H
			CALL ESC_INST

			MOV A,#80H
			CALL ESC_INST
			MOV DPTR,#50H
			CALL TEXTO							;MUESTRA POR PANTALLA 
			MOV A,#0C0H							;'1:Frecuencimetro 2:Generador SC'
			CALL ESC_INST
			MOV DPTR,#66H
			CALL TEXTO
			
			MOV P1,#0FH
S6:			MOV A,P1						  	;COMPRUEBA QUE NO
			CJNE A,#0FH,S6					  	;HAYA TECLAS PULSADAS

TECLANUEVA:	MOV P1,#0F0H				
NOTECLA1:	
			
			MOV A,P1
			CJNE A,#0F0H,S5
			JMP NOTECLA1						
S5:			MOV R7,A
			MOV P1,#0FH
			MOV A,P1							;GUARDA EL VALOR DE LA 
			ORL A,R7        					;TECLA PULSADA EN EL ACUMULADOR
										   	
			CJNE A,#0E7H,T2
			MOV A,#"1"
			MOV R3,#1
  			JMP FRECU							;SALTA AL FRECUENCIMETRO
T2:			CJNE A,#0EBH,TECLANUEVA				;SI LA TECLA PULSADA NO ES NI 1 NI 2, VUELVE A COMPROBAR OTRA TECLA
			MOV A,#"2"
			MOV R3,#2
			JMP GEN								;SALTA AL GENERADOR DE SEÑAL CUADRADA


/**************************************************
*************     FRECUENCIMETRO   ****************
***************************************************/
/*	  HABILITA: INT0->FLANCO DESCENDENTE    			   		
				GUARDA EL TIEMPO EN ON Y LIMPIA LAS VARIABLES AUXILIARES (2º MAS PRIORITARIA)

				INT1->FLANCO ASCENDENTE(INVERSOR EN EL PIN) 	
				CUENTA LOS PULSOS,A FLANCO ASCENDENTE PARA MEDIR FRECUENCIA (1º MAS PRIORITARIA)

				TIMER 0-> MODO 2(8 BITS,AUTORRECARGA)  VALOR CARGADO->156D   HABILITADO PARA QUE CUENTE 100 uS (GATE A 1,DEPENDE DEL PIN INT0)
				MIDE EL TIEMPO EN ON, DE 50 EN 50 us    				(3º MAS PRIORITARIA)

				TIMER 1-> MODO 1(16 BITS)              VALOR CARGADO->3CAF(15535) HABILITADO PARA QUE CUENTE 50 mS
				SE ENCARGA DEL REFRESCO DE PANTALLA,RUTINA MUY LARGA, ES LA MENOS PRIORITARIA
				ESTA CONTANDO CONTINUAMENTE (GATE A 0,SIEMPRE HABILITADA)
				

 */
FRECU:  	
			MOV IE,#80H
			MOV SCON,#90H
			MOV PCON,#00H
			SETB REN
			MOV A,#0E7H
			CALL ESC_TRANS
			CALL RECIBE_DATO
			
ESCRIBEFR:	
			MOV A,#01H				 		 ;MUESTRA POR PANTALLA FRECUENCIA Y TIEMPO EN ON
			CALL ESC_INST
			MOV A,#80H
			CALL ESC_INST
			MOV DPTR,#0F00H
			MOV R3,#02H
			CALL TEXTO2
			MOV A,#0C0H
			CALL ESC_INST
			MOV DPTR,#0F10H
			MOV R3,#00H
			CALL TEXTO2
			
			MOV TMOD,#1AH			  		;CONFIGURACION DE TEMPORIZADORES Y INTERRUPCIONES
			MOV TH0,#206D			  		;TIMER 0 CONFIGURADO PARA QUE CADA 50 uS SALTE A LA
			MOV TL0,#206D			  		;INTERRUPCIÓN
			MOV TH1,#3CH
			MOV TL1,#0AFH
			MOV IP,#04H				 		
			MOV IE,#80H
			MOV TCON,#05H
			MOV R5,#20D						 ;SE CARGA ESTE VALOR QUE LUEGO SERA DECREMENTADO EN LA SUBRUTINA DE REFRESCO DE PANTALLA
			SETB TR1						 ;PARA QUE CUENTE 250 mS ( 5 * 50 mS )						 
			SETB TR0						 ;LOS TIMERS COMIENZAN A CONTAR

RECIBE_DATOS:
			MOV A,#8CH						  ;MUESTRA POR PANTALLA LA FRECUENCIA
			CALL ESC_INST
			
SIGUERECIBIENDO:		
		
			CALL RECIBE_DATO
			CALL ESC_TRANS		

			CALL RECIBE_DATO
			CALL ESC_TRANS
			CALL ESC_DATO
			
			CALL RECIBE_DATO
			CALL ESC_TRANS
			CALL ESC_DATO		  
			
			CALL RECIBE_DATO
			CALL ESC_TRANS
			CALL ESC_DATO

			CALL RECIBE_DATO
			CALL ESC_TRANS
			CALL ESC_DATO

			CALL RECIBE_DATO
			CALL ESC_TRANS
			CALL ESC_DATO
			
			
			CALL RECIBE_DATO
			CJNE A,#0FFH,DATOVALIDO
			JMP SIGUE_MOSTRANDO
DATOVALIDO:	CALL ESC_TRANS
			CALL ESC_DATO

			CALL RECIBE_DATO
			CJNE A,#0FFH,DATOVALIDO2
			JMP SIGUE_MOSTRANDO
DATOVALIDO2:CALL ESC_TRANS
			CALL ESC_DATO

			CALL RECIBE_DATO
			CJNE A,#0FFH,DATOVALIDO3
			JMP SIGUE_MOSTRANDO
DATOVALIDO3:	CALL ESC_TRANS
			CALL ESC_DATO
		  
SIGUE_MOSTRANDO:
				
			MOV A,#0CDH						  ;MUESTRA POR PANTALLA LA FRECUENCIA
			CALL ESC_INST
			
			
			MOV P2,#0FH
			CALL RECIBE_DATO
			CALL ESC_TRANS
			MOV P2,#0f0H
			
			CALL ESC_DATO
			
			CALL RECIBE_DATO
			CALL ESC_TRANS
			CALL ESC_DATO
		/*	
			CALL RECIBE_DATO
			CALL ESC_TRANS
			CALL ESC_DATO

			CALL RECIBE_DATO
			CALL ESC_TRANS
			CALL ESC_DATO		 */

		/*	CALL RECIBE_DATO
			CJNE A,#0FFH,DATOVALIDO4
			JMP SIGUE_MOSTRANDO2
DATOVALIDO4:	CALL ESC_TRANS
			CALL ESC_DATO

			CALL RECIBE_DATO
			CJNE A,#0FFH,DATOVALIDO5
			JMP SIGUE_MOSTRANDO2
DATOVALIDO5:CALL ESC_TRANS
			CALL ESC_DATO

			CALL RECIBE_DATO
			CJNE A,#0FFH,DATOVALIDO6
			JMP SIGUE_MOSTRANDO2
DATOVALIDO6:CALL ESC_TRANS
			CALL ESC_DATO
								  */
						  
SIGUE_MOSTRANDO2:  
			;JMP RECIBE_DATOS


FIN:			JMP FIN				  ;ESTA MIERDA CAMBIARLA POR UN RESET
			
;RUTINAS DE RECEPCIÓN Y TRANSMISIÓN.

ESC_TRANS:			
			MOV SBUF,A
BT1:		JNB TI,BT1         			
			CLR TI
			RET

RECIBE_DATO:JNB RI,RECIBE_DATO
			CLR RI
			MOV A,SBUF
			
			RET
/**************************************************
*************        TIMER 1       ****************
***************************************************/			
;**********MODIFICA -->R5, Acc      

REFRESCO:/*							  	;REFRESCO DE PANTALLA 
			DJNZ R5,S7					;SI EL REGISTRO NO SE HA DECREMENTADO 5 VECES,SIGNIFICA QUE NO HAN PASADO 0,25 SG Y QUE NO ES NECESARIO
			MOV R5,#20D					;ACTUALIZAR LA PANTALLA TODAVIA
			MOV TH1,#3CH		   		
			MOV TL1,#0AFH				
			JMP ACTU
S7:			MOV TH1,#3CH
			MOV TL1,#0AFH
			LJMP NO_ACTU

ACTU:			MOV A,SALTAAFRECM1
				CJNE A,#00H,FRECM2C
			JMP SIGUEFREC11
FRECM2C:	LJMP FRECM2
SIGUEFREC11:	MOV A,HZ_H		  			;CONVERSION A BCD DE LA PARTE ALTA DEL CONTADOR DE FRECUENCIA
			MOV B,#100D
			DIV AB
			MOV CENHZH,A
			MOV A,B
			MOV B,#10D
			DIV AB
			MOV DECHZH,A
			MOV UNIHZH,B

			MOV A,HZ_L		  			;CONVERSION A BCD DE LA PARTE BAJA DEL CONTADOR DE FRECUENCIA
				
				CJNE A,#00H,SIGUEFREC
				MOV A,HZ_H
				CJNE A,#00H,SIGUEFREC
				JMP FRECM1
SIGUEFREC:	MOV B,#100D
			DIV AB
			MOV CENTENAS,A
			MOV A,B
			MOV B,#10D
			DIV AB
			MOV DECENAS,A
			MOV UNIDADES,B
						

			MOV A,UNIHZH	   			;COMPARACION DE LAS UNIDADES DE LA PARTE ALTA DEL CONTADOR
			CJNE A,#01H,V2	   			;DE FRECUENCIA,PARA SUMAR LOS VALORES ADECUADOS,SEGUN EL VALOR				TABLA DE VALORES
			MOV SUMAUNI,#6D	   			;DETECTADO EN LAS UNIDADES
			MOV SUMADEC,#5D
			MOV SUMACEN,#2D
			MOV SUMAMIL,#0D
			JMP SUMA_VALORES
V2:			CJNE A,#2H,V3
			MOV SUMAUNI,#2D
			MOV SUMADEC,#1D
			MOV SUMACEN,#5D
			MOV SUMAMIL,#0D
			JMP SUMA_VALORES
V3:			CJNE A,#3H,V4
			MOV SUMAUNI,#8D
			MOV SUMADEC,#6D
			MOV SUMACEN,#7D
			MOV SUMAMIL,#0D
			JMP SUMA_VALORES
V4:			CJNE A,#4H,V5
			MOV SUMAUNI,#4D
			MOV SUMADEC,#2D
			MOV SUMACEN,#0D
			MOV SUMAMIL,#1D
			JMP SUMA_VALORES
V5:			CJNE A,#5H,V6
			MOV SUMAUNI,#0D
			MOV SUMADEC,#8D
			MOV SUMACEN,#2D
			MOV SUMAMIL,#1D
			JMP SUMA_VALORES
V6:			CJNE A,#6H,V7
			MOV SUMAUNI,#6D
			MOV SUMADEC,#3D
			MOV SUMACEN,#5D
			MOV SUMAMIL,#1D
			JMP SUMA_VALORES
V7:			CJNE A,#7H,V8
			MOV SUMAUNI,#2D
			MOV SUMADEC,#9D
			MOV SUMACEN,#7D
			MOV SUMAMIL,#1D
			JMP SUMA_VALORES
V8:			CJNE A,#8H,V9
			MOV SUMAUNI,#8D
			MOV SUMADEC,#4D
			MOV SUMACEN,#0D
			MOV SUMAMIL,#2D
			JMP SUMA_VALORES
V9:			CJNE A,#9H,V0
			MOV SUMAUNI,#4D
			MOV SUMADEC,#0D
			MOV SUMACEN,#3D
			MOV SUMAMIL,#2D
			JMP SUMA_VALORES
V0:			JMP S17                   		;SALTA A
			

/* LA SUBRUTINA SUMA_VALORES  SE ENCARGA DE SUMAR LOS VALORES EXTRAIDOS DE LA TABLA 
CON LOS HALLADOS AL CONVERTIR A BCD LA PARTE BAJA DEL FRECUENCIMETRO BINARIO*/
 /*
SUMA_VALORES:						   
			MOV A,UNIDADES			  			;UNIDADES
			ADD A,SUMAUNI
			MOV TEMP1,A
			SUBB A,#10D
			JC S10
 			INC DECENAS
			MOV UNIDADES,A
			JMP S14
S10:		MOV UNIDADES,TEMP1
S14:		MOV A,DECENAS			 			;DECENAS
			ADD A,SUMADEC
			MOV TEMP1,A
			SUBB A,#10D
			JC S11
			INC CENTENAS
			MOV DECENAS,A						   
			JMP S15
S11:		MOV DECENAS,TEMP1
S15:			MOV A,CENTENAS			 		;CENTENAS
			ADD A,SUMACEN
			MOV TEMP1,A
			SUBB A,#10D
			JC S12
			INC MILLARES
			MOV CENTENAS,A
			JMP S16
S12:		MOV CENTENAS,TEMP1
S16:		MOV A,MILLARES		 				;MILLARES
			ADD A,SUMAMIL
			MOV TEMP1,A
			SUBB A,#10D
			JC S13
			MOV MILLARES,A
			JMP S17
S13:		MOV MILLARES,TEMP1
S17:													 
		
			MOV A,DECHZH								  
			
SALTOHZH1:	CJNE A,#3D,SIGUEFREC2		  		;SI LA PARTE ALTA ES MAYOR DE 10(FRECUENCIA MAYOR DE 2559)
							  		;SUMA 2560 A LA FRECUENCIA MEDIDA POR LA PARTE BAJA (HZ_L)
			MOV SUMAMIL,#7D
			MOV SUMACEN,#6D
			MOV SUMADEC,#8D
			MOV SUMAUNI,#0D
			MOV DECHZH,#00H
			JMP S14


SIGUEFREC2:	CJNE A,#2D,SIGUEFREC1		  		;SI LA PARTE ALTA ES MAYOR DE 10(FRECUENCIA MAYOR DE 2559)
										  		;SUMA 2560 A LA FRECUENCIA MEDIDA POR LA PARTE BAJA (HZ_L)
			MOV SUMAMIL,#5D
			MOV SUMACEN,#1D
			MOV SUMADEC,#2D
			MOV SUMAUNI,#0D
			MOV DECHZH,#00H
			JMP S14
SIGUEFREC1:	CJNE A,#1D,MUESTRA_FREC		  		;SI LA PARTE ALTA ES MAYOR DE 10(FRECUENCIA MAYOR DE 2559)
			MOV DECHZH,#00H				  		;SUMA 2560 A LA FRECUENCIA MEDIDA POR LA PARTE BAJA (HZ_L)
			MOV SUMAMIL,#2D
			MOV SUMACEN,#5D
			MOV SUMADEC,#6D
			MOV SUMAUNI,#0D
			MOV DECHZH,#00H
			JMP S14
							  
MUESTRA_FREC:
			MOV A,MILLARES				  		;CONVIERTE EN ASCII EL CODIGO BDC
			ADD A,#30H					  		;PARA LUEGO MOSTRARLO POR PANTALLA
			MOV MILLARES,A
			MOV A,CENTENAS
			ADD A,#30H
			MOV CENTENAS,A
			MOV A,DECENAS
			ADD A,#30H
			MOV DECENAS,A
			MOV A,UNIDADES
			ADD A,#30H
			MOV UNIDADES,A
			
				*/
								  ;Y LUEGO LIMPIA TODAS LAS POSICIONES DE MEMORIA
		
		
		
		
		/*	MOV A,MILLARES
			CJNE A,#30H,NONULO1
			JMP NULO1						  ;LOS CJNE ESTAN PARA QUE NO MUESTRE LOS CEROS A LA IZQUIERDA

NONULO1:	INC TEMP2
			CALL ESC_DATO
			JMP SIGUE

NULO1:		MOV A,CENTENAS
			CJNE A,#30H,NONULO2
			INC TEMP2
			JMP NULO2

SIGUE:		MOV A,CENTENAS
NONULO2:	CALL ESC_DATO
			JMP SIGUE2

NULO2:		MOV A,TEMP2
			CJNE A,#1H,SIGUE2
			MOV A,CENTENAS
			CJNE A,#30H,NONULO3
			INC TEMP2
			JMP SIGUE3

SIGUE2:		MOV A,DECENAS
			CALL ESC_DATO
			JMP NULO3
SIGUE3:		MOV A,TEMP2
			CJNE A,#2H,NONULO3
			MOV A,DECENAS
			CJNE A,#30H,NONULO3
			JMP NULO3

NONULO3:	CALL ESC_DATO
NULO3:		MOV A,UNIDADES
			CALL ESC_DATO
			MOV A,#'H'
			CALL ESC_DATO
			MOV A,#'z'
			CALL ESC_DATO
	
			MOV TEMP2,#00H
			MOV DECHZH,#00H
			MOV UNIHZH,#00H
			MOV MILLARES,#00H
			MOV CENTENAS,#00H
			MOV DECENAS,#00H
			MOV UNIDADES,#00H
			MOV HZ_L,#00H
			MOV HZ_H,#00H
			JMP MUESTRATON

	FRECM1:		
	FRECM2:		INC SALTAAFRECM1	
				MOV A,HZ_L
				CJNE A,#01H,OTRAFREC
				MOV A,#8CH						  ;MUESTRA POR PANTALLA LA FRECUENCIA
				CALL ESC_INST
				MOV A,SALTAAFRECM1
				CJNE A,#01H,SIGUIENTEFREC
				MOV A,#'0'
				CALL ESC_DATO
				MOV A,#','
				CALL ESC_DATO
				MOV A,#'5'
				CALL ESC_DATO
				MOV A,#'0'
				CALL ESC_DATO
				MOV A,#'H'
				CALL ESC_DATO
				MOV A,#'z'
				CALL ESC_DATO
				JMP MUESTRATON
SIGUIENTEFREC:	
				MOV A,#'0'
				CALL ESC_DATO
				MOV A,#','
				CALL ESC_DATO
				MOV A,#'2'
				CALL ESC_DATO
				MOV A,#'5'
				CALL ESC_DATO
				MOV A,#'H'
				CALL ESC_DATO
				MOV A,#'z'
				CALL ESC_DATO
				JMP MUESTRATON
OTRAFREC:		/*MOV A,#8CH						  ;MUESTRA POR PANTALLA LA FRECUENCIA
				CALL ESC_INST
				MOV A,#'E'
				CALL ESC_DATO */

MUESTRATON:	MOV A,#0CDH					    	;RUTINA DE ESCRITURA DEL TIEMPO EN ON EN PANTALLA
			CALL ESC_INST
			
		/*	MOV A,SEGTON
			ADD A,#30H
			CJNE A,#30H,SG						;SI LOS SEGUNDOS NO SON NULOS, ESCRIBE EL VALOR DE LOS SEGUNDOS
			JMP MSG								;Y DE LAS DECIMAS DE SEGUNDO,Y LUEGO ESCRIBE 'SG'
SG:			CALL ESC_DATO
			MOV A,#','							;SI SON NULOS (TIEMPO MENOR DE UN SEGUNDO)SALTA A MSG(RUTINA DE MILISEGUNDOS)
			CALL ESC_DATO
			MOV A,CMILTON
			ADD	A,#30H
			CALL ESC_DATO
			
			MOV TIEMPO1,#'S'
			MOV TIEMPO2,#'G'
			MOV A,TIEMPO1
			CALL ESC_DATO
			MOV A,TIEMPO2
			CALL ESC_DATO
			
			JMP NO_ACTU

MSG:		MOV A,CMILTON						;SI LOS SEGUNDO SON NULOS LLEGAMOS AQUI
			ADD A,#30H
			CJNE A,#30H,MSG1					;SI LAS CENTENAS DE MILISG NO SON NULAS,ESCRIBE CENTENAS,DECENAS,UNIDADES, Y DECIMAS DE MILISG
			JMP MSG0							;SINO,SALTA A MSG0 (PARA COMPROBAR SI LAS DECENAS TAMBIEN SON NULAS)

MSG1:		CALL ESC_DATO
			MOV A,DMILTON
			ADD A,#30H
			CALL ESC_DATO
			MOV A,MILTON
			ADD A,#30H
			CALL ESC_DATO
			MOV A,#','
			CALL ESC_DATO
			MOV A,CENTON
			ADD	A,#30H
			CALL ESC_DATO
			
			MOV TIEMPO1,#'m'
			MOV TIEMPO2,#'S'
			MOV A,TIEMPO1
			CALL ESC_DATO
			MOV A,TIEMPO2
			CALL ESC_DATO
			JMP NO_ACTU

MSG0:		MOV A,DMILTON					   ;AQUI COMPRUEBA SI LAS DECENAS DE MILISG SON NULAS,SI NO LO SON ESCRIBE DECENAS Y UNIDADES DE MILISG
			ADD A,#30H						   ;Y DECIMAS DE MILISG	(CENTENAS DE MICROSG)
			CJNE A,#30H,MSG2
			JMP MSG3						   ;SINO SALTA A COMPROBAR LAS UNIDADES DE MILISG
MSG2:		CALL ESC_DATO
			MOV A,MILTON
MSG4:		ADD A,#30H
			CALL ESC_DATO
			MOV A,#','
			CALL ESC_DATO
			MOV A,CENTON
			ADD	A,#30H
			CALL ESC_DATO
			
			MOV TIEMPO1,#'m'
			MOV TIEMPO2,#'S'
			MOV A,TIEMPO1
			CALL ESC_DATO
			MOV A,TIEMPO2
			CALL ESC_DATO
			JMP NO_ACTU
			
MSG3:		MOV A,MILTON						 ;AQUI COMPRUEBA LAS UNIDADES DE MILISG, SINO SON NULAS SALTA A MSG4,Y LAS MUESTRA POR PANTALLA
			CJNE A,#00H,MSG4					 ;PERO SI SON NULAS,CONTINUA POR AQUI Y SOLO ESCRIBE CENTENAS DE MICRO SEGUNDO.
			
			MOV A,CENTON
			ADD A,#30H
			CALL ESC_DATO
			
			MOV A,MCENTON
			MOV B,#5D
			MUL AB
			MOV MCENTON,A
			MOV A,TIMERBAJO
			SUBB A,#206D
			MOV B,#10D
			DIV AB
			MOV TIMERBAJO,B
			ADD A,MCENTON
			ADD A,#30H
			CALL ESC_DATO
			MOV A,TIMERBAJO
			ADD A,#30H
			CALL ESC_DATO


			SETB TR0
			/*MOV A,#'0'
			CALL ESC_DATO*/
		/*	
			MOV TIEMPO1,#'u'
			MOV TIEMPO2,#'s'
			MOV A,TIEMPO1
			CALL ESC_DATO
			MOV A,TIEMPO2
			CALL ESC_DATO
NO_ACTU:	setb tr0									 ;FIN DE LA RUTINA DE MUESTREO POR PANTALLA DE TIEMPO EN ON
			RET				   */

							   


/**************************************************
*****     GENERADOR DE SEÑALES CUADRADAS	*******
***************************************************/
/*	  HABILITA: INT0->NO   			   		
				
				INT1->NO	
				
				TIMER 0->NO 
				
				TIMER 1-> NO

				PUERTO 2 -> UTILIZA LA PATILLA 0 DEL PUERTO 2 PARA GENERAR SEÑALES
				

 */


GEN: 	   	MOV A,#0H
			CALL ESC_TRANS
			
			MOV IE,#80H
			MOV SCON,#90H
			MOV PCON,#00H
			SETB REN
			

			MOV A,#01H				 		 ;MUESTRA POR PANTALLA selecciona un duty cycle
			CALL ESC_INST
			MOV A,#80H
			CALL ESC_INST
			MOV DPTR,#0F20H
			MOV R3,#04H
			CALL TEXTO3
			MOV A,#0C0H
			CALL ESC_INST
			MOV DPTR,#0F30H
			MOV R3,#00H
			CALL TEXTO3

			MOV P1,#0FH
GS1:		MOV A,P1						  	;COMPRUEBA QUE NO
			CJNE A,#0FH,GS1					  	;HAYA TECLAS PULSADAS

GTECLANUEVA:MOV P1,#0F0H				
GNOTECLA1:	MOV A,P1
			CJNE A,#0F0H,GS2
			JMP GNOTECLA1						
GS2:		MOV R7,A
			MOV P1,#0FH
			MOV A,P1							;GUARDA EL VALOR DE LA 
			ORL A,R7        					;TECLA PULSADA EN EL ACUMULADOR
										   	
			CJNE A,#0E7H,GTE2
			MOV DUTYPORCEN,#1D
  			JMP GSIGUE							;SALTA AL FRECUENCIMETRO
GTE2:		CJNE A,#0EBH,GTE3					;SI LA TECLA PULSADA NO ES NI 1 NI 2, VUELVE A COMPROBAR OTRA TECLA
			MOV DUTYPORCEN,#2D
			JMP GSIGUE																  
GTE3:		CJNE A,#0EDH,GS1
			MOV DUTYPORCEN,#3D
  											  ;COMPRUEBA QUE TECLA HA SIDO PULSADA
GSIGUE:		

			MOV A,DUTYPORCEN
			CALL ESC_TRANS										
			CALL RECIBE_DATO

			MOV A,#1H
			CALL ESC_INST
			MOV A,#80H
			CALL ESC_INST
			MOV DPTR,#0F44H
			MOV R3,#02H
			CALL TEXTO3
			MOV A,#0C0H
			CALL ESC_INST
			MOV DPTR,#0F57H
			MOV R3,#08H
			CALL TEXTO3
			
GOTRA_VEZ:	MOV P1,#0FH
GS3:		MOV A,P1						  	;COMPRUEBA QUE NO
			CJNE A,#0FH,GS3					  	;HAYA TECLAS PULSADAS

GTECLANUEVA2:MOV P1,#0F0H				
GNOTECLA2:	MOV A,P1
			CJNE A,#0F0H,GS4
			JMP GNOTECLA2						
GS4:		MOV R7,A
			MOV P1,#0FH
			MOV A,P1							;GUARDA EL VALOR DE LA 
			ORL A,R7  	
		
		  ;rutina de deteccion de tecla pulsada
			CJNE A,#0E7H,GT2
			MOV A,#"1"
			MOV R3,#1
  			JMP ESC_NUMERO
GT2:		CJNE A,#0EBH,GT3
			MOV A,#"2"
			MOV R3,#2
			JMP ESC_NUMERO
GT3:		CJNE A,#0EDH,GT4
			MOV A,#"3"
			MOV R3,#3
			JMP ESC_NUMERO
GT4:		CJNE A,#0D7H,GT5
			MOV A,#"4"
			MOV R3,#4
			JMP ESC_NUMERO
GT5:		CJNE A,#0DBH,GT6
			MOV A,#"5"
			MOV R3,#5
			JMP ESC_NUMERO
GT6:		CJNE A,#0DDH,GT7
			MOV A,#"6"
			MOV R3,#6
			JMP ESC_NUMERO
GT7:		CJNE A,#0B7H,GT8
			MOV A,#"7"
			MOV R3,#7
			JMP ESC_NUMERO
GT8:		CJNE A,#0BBH,GT9
			MOV A,#"8"
			MOV R3,#8
		    JMP ESC_NUMERO
GT9:		CJNE A,#0BDH,GT0
			MOV A,#"9"
			MOV R3,#9
			JMP ESC_NUMERO
GT0:		CJNE A,#07BH,GTECLANUEVA2
			MOV A,#"0"
			MOV R3,#0

ESC_NUMERO: CALL ESC_DATO
			MOV MILGEN,CENGEN
			MOV CENGEN,DECGEN						;CONSEGUIR QUE SE PUEDA PULSAR INTRO EN CUALQUIER MOMENTO(Y QUE OMITA LOS CEROS A LA IZQUIERDA)
			MOV DECGEN,UNIGEN
			MOV UNIGEN,R3
			INC R4
			
			


			MOV P1,#0FH
GS6:		MOV A,P1						  	;COMPRUEBA QUE NO
			CJNE A,#0FH,GS6	

TECLANUEVA3:MOV P1,#0F0H				
GNOTECLA3:	MOV A,P1
			CJNE A,#0F0H,GS5
			JMP GNOTECLA3						
GS5:		MOV R7,A
			MOV P1,#0FH
			MOV A,P1							;GUARDA EL VALOR DE LA 
			ORL A,R7  	
			
			CJNE A,#077H,GOTRA_VEZ2

			JMP MUESTRA_FRECG
GOTRA_VEZ2:	JMP GOTRA_VEZ		
			

			

MUESTRA_FRECG:
			
			MOV A,MILGEN
			CALL ESC_TRANS
			CALL RECIBE_DATO
			MOV A,CENGEN
			CALL ESC_TRANS
			CALL RECIBE_DATO
			MOV A,DECGEN
			CALL ESC_TRANS
			CALL RECIBE_DATO
			MOV A,UNIGEN
			CALL ESC_TRANS
			
			CALL RECIBE_DATO
			
			
			
			MOV A,#01H
			CALL ESC_INST
			MOV A,#80H
			CALL ESC_INST
			MOV DPTR,#0F70H
			MOV R3,#02H
			CALL TEXTO3
			
			
			;ESCRIBIR POR PANTALLA GENERANDO FRECUENCIA DESEADA POR EL PIN 2.0
FIN3:		JMP FIN3


;___________________________________________________________________


 
TEXTO:		CLR A						;ESTA ZONA DE CODIGO ESCRIBE POR PANTALLA "Introduce un numero"
			MOVC A,@A+DPTR	
			CALL ESC_DATO
			INC DPTR
			INC R3
			CJNE R3,#16D,TEXTO
			MOV R3,#00
			MOV DPL,R0
			MOV DPH,R1
			RET

TEXTO2:		CLR A						;ESTA ZONA DE CODIGO ESCRIBE POR PANTALLA "Introduce un numero"
			MOVC A,@A+DPTR	
			CALL ESC_DATO
			INC DPTR
			INC R3
			CJNE R3,#13D,TEXTO2
			MOV R3,#00
			MOV DPL,R0
			MOV DPH,R1
			RET

TEXTO3:		CLR A						;ESTA ZONA DE CODIGO ESCRIBE POR PANTALLA "Introduce un numero"
			MOVC A,@A+DPTR	
			CALL ESC_DATO
			INC DPTR
			INC R3
			CJNE R3,#20D,TEXTO3
			MOV R3,#00
			MOV DPL,R0
			MOV DPH,R1
			RET
;ZONA DE TEXTOS MOSTRADOS POR PANTALLA 

			ORG 0030H
			DB 'Pulse una tecla'
			ORG 0040H
			DB 'para continuar.'
			ORG 0050H
			DB '1:Frecuencimetro'
			ORG 0066H
			DB '2:Generador SC'
			ORG 0F00H
			DB 'Frecuencia:'   ;11
			ORG 0F10H
			DB 'Tiempo en ON:' ;13
			ORG 0F20H
			DB 'Elige Duty Cycle'
			ORG 0F30H
			DB '1-25%  2-50%  3-75%'
			ORG 0F44H
			DB 'Frecuencia deseada'
			ORG 0F57H
			DB '[1-2000 Hz]:'
			ORG 0F70H
			DB 'Generando onda...'
			ORG 0F81H
			DB ' Frecuencimetro y Generador de S.C.'
			ORG 10F0H
			DB 'Realizado por Santiago J. Gonzalez'
			END